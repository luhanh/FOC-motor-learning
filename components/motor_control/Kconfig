## components/motor_control/Kconfig
```kconfig
menu "Motor Control"

    config SENSOR_AS5600_ENABLE
        bool "Enable AS5600 magnetic encoder"
        default y
        help
            Enable AS5600 I2C magnetic encoder driver.
            Required for FOC closed-loop control with position feedback.

endmenu
```
